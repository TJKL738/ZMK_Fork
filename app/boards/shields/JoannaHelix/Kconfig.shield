## app/boards/shields/JoannaHelix/Kconfig.shield
```kconfig
# Copyright (c) 2023 The ZMK Contributors
# SPDX-License-Identifier: MIT

config SHIELD_JOANNA_HELIX_LEFT
    def_bool $(shields_list_contains,JOANNA_HELIX_LEFT)

config SHIELD_JOANNA_HELIX_RIGHT
    def_bool $(shields_list_contains,JOANNA_HELIX_RIGHT)
```
